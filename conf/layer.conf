## conf/layer.conf
```bitbake
# We have a conf and classes directory, add to BBPATH
BBPATH .= ":${LAYERDIR}"

# We have recipes-* directories, add to BBFILES
BBFILES += "${LAYERDIR}/recipes-*/*/*.bb \
            ${LAYERDIR}/recipes-*/*/*.bbappend"

BBFILE_COLLECTIONS += "meta-neilim"
BBFILE_PATTERN_meta-neilim = "^${LAYERDIR}/"
BBFILE_PRIORITY_meta-neilim = "7"

LAYERDEPENDS_meta-neilim = "core"
LAYERSERIES_COMPAT_meta-neilim = "kirkstone"
```
